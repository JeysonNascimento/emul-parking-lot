## CMakeLists.txt
```
# Suíte da camada de hardware real (hw.c) contra os modelos do Renode:
# GPIO, EXTI e ADC4 assíncrono de verdade, sem falsos.
cmake_minimum_required(VERSION 3.20.0)
list(APPEND BOARD_ROOT ${CMAKE_CURRENT_SOURCE_DIR}/../../../hardware)
list(APPEND DTS_ROOT ${CMAKE_CURRENT_SOURCE_DIR}/../../../hardware)
find_package(Zephyr REQUIRED HINTS $ENV{ZEPHYR_BASE})
project(parking_test_hw)
target_include_directories(app PRIVATE ../../src)
target_sources(app PRIVATE
	src/test_hw.c
	../../src/hw.c
)
```

## prj.conf
```kconfig
CONFIG_CONSOLE=y
CONFIG_UART_CONSOLE=y
CONFIG_PRINTK=y
CONFIG_SERIAL=y
CONFIG_GPIO=y
CONFIG_SPI=y
CONFIG_ADC=y
CONFIG_ADC_ASYNC=y
CONFIG_PM=n
CONFIG_ZTEST=y
```

## src/test_hw.c
```c
/*
 * Testes da camada de hardware real (hw.c) na placa simulada.
 * No início da suíte as cancelas estão fechadas, os feixes livres e os
 * carros a 6000 mm (código 4095).
 */
#include <errno.h>

#include <zephyr/kernel.h>
#include <zephyr/ztest.h>

#include "hw.h"

static int handler_calls;

static void handler(enum lane_id lane)
{
	ARG_UNUSED(lane);
	handler_calls++;
}

static void *setup(void)
{
	zassert_ok(hw_init(handler));
	return NULL;
}

ZTEST_SUITE(hw, NULL, setup, NULL, NULL, NULL);

ZTEST(hw, test_inputs_at_reset)
{
	for (int lane = 0; lane < LANE_COUNT; lane++) {
		zassert_equal(hw_in_get((enum lane_id)lane, HW_IN_LOWER), 1);
		zassert_equal(hw_in_get((enum lane_id)lane, HW_IN_UPPER), 0);
		zassert_equal(hw_in_get((enum lane_id)lane, HW_IN_BEAM), 0);
	}
}

ZTEST(hw, test_outputs_accept_writes)
{
	for (int lane = 0; lane < LANE_COUNT; lane++) {
		zassert_ok(hw_out_set((enum lane_id)lane, HW_OUT_RED, true));
		zassert_ok(hw_out_set((enum lane_id)lane, HW_OUT_GREEN, false));
	}
}

/* Converte um canal e espera a conclusão sem passar do prazo de 100 ms. */
static int convert(enum lane_id lane, uint16_t *raw)
{
	int64_t start = hw_now_ms();
	int rc;

	zassert_ok(hw_adc_start(lane));
	do {
		rc = hw_adc_poll(raw);
		if (rc != -EINPROGRESS) {
			return rc;
		}
		k_msleep(1);
	} while (hw_now_ms() - start < 100);
	return -ETIMEDOUT;
}

ZTEST(hw, test_adc_reads_far_vehicle_on_both_channels)
{
	uint16_t raw = 0;

	zassert_ok(convert(LANE_ENTRY, &raw));
	zassert_true(raw >= 4095 - 64, "entrada: código %u", raw);
	raw = 0;
	zassert_ok(convert(LANE_EXIT, &raw));
	zassert_true(raw >= 4095 - 64, "saída: código %u", raw);
}

ZTEST(hw, test_adc_poll_is_nonblocking)
{
	uint16_t raw;
	int64_t before = hw_now_ms();
	int rc;

	zassert_ok(hw_adc_start(LANE_ENTRY));
	rc = hw_adc_poll(&raw);
	zassert_true(rc == 0 || rc == -EINPROGRESS, "rc %d", rc);
	zassert_true(hw_now_ms() - before < 10, "poll bloqueou");
	/* Deixa a mesma conversão terminar antes do próximo teste. */
	while (rc == -EINPROGRESS && hw_now_ms() - before < 100) {
		k_msleep(1);
		rc = hw_adc_poll(&raw);
	}
	zassert_ok(rc);
}

ZTEST(hw, test_sched_lock_pairs)
{
	hw_sched_lock();
	hw_sched_unlock();
	zassert_equal(handler_calls, 0, "nenhuma entrada mudou");
}
```
